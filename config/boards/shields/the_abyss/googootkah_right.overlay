#include "googootkah.dtsi"

/ {
    chosen {
        zmk,display = &oled;
        zmk,kscan = &default_kscan;
        zmk,matrix_transform = &default_transform;
    };

    oled: ssd1306@3c {
        compatible = "solomon,ssd1306fb";
        reg = <0x3c>;
        label = "SSD1306";
        width = <128>;
        height = <32>;
        rotation = <0>;
        bus-speed = <100000>;
        segment-offset = <14>;      // desna polovina startuje od kolone 14
        // reset-gpios = <&gpio0 29 GPIO_ACTIVE_LOW>;  // ako koristiš reset pin
    };

    &default_transform {
        col-offset = <14>;  // desna polovina startuje od kolone 14
    };
};
