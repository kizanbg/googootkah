/ {
    compatible = "zmk,keyboard";

    chosen {
        zmk,kscan = &kscan0;
    };

    kscan0: kscan {
        compatible = "zmk,kscan-direct";
        label = "KSRight";
        input-gpios = <
            &gpio0 31 (GPIO_ACTIVE_LOW)
            &gpio0 29 (GPIO_ACTIVE_LOW)
            &gpio0 2  (GPIO_ACTIVE_LOW)
            &gpio1 15 (GPIO_ACTIVE_LOW)
            &gpio1 13 (GPIO_ACTIVE_LOW)
            &gpio1 11 (GPIO_ACTIVE_LOW)
            &gpio0 10 (GPIO_ACTIVE_LOW)
            &gpio0 9  (GPIO_ACTIVE_LOW)
            &gpio1 6  (GPIO_ACTIVE_LOW)
            &gpio1 4  (GPIO_ACTIVE_LOW)
            &gpio0 11 (GPIO_ACTIVE_LOW)
            &gpio1 0  (GPIO_ACTIVE_LOW)
            &gpio0 24 (GPIO_ACTIVE_LOW)
            &gpio0 22 (GPIO_ACTIVE_LOW)
        >;
    };
};
